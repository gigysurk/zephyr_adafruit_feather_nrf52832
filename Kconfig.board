## Kconfig.board
```kconfig
# Adafruit Feather nRF52840 Express board configuration

# Copyright (c) 2020 Tobias Svehagen
# SPDX-License-Identifier: Apache-2.0

config BOARD_ADAFRUIT_FEATHER_NRF52832
	bool "Adafruit Feather nRF52832"
	depends on SOC_NRF52832_QFAA
```

## Kconfig.defconfig
```kconfig
# Adafruit Feather nRF52840 Express board configuration

# Copyright (c) 2020 Tobias Svehagen
# SPDX-License-Identifier: Apache-2.0

if BOARD_ADAFRUIT_FEATHER_NRF52832

config BOARD
	default "adafruit_feather_nrf52832"

config BT_CTLR
	default BT

endif # BOARD_ADAFRUIT_FEATHER_NRF52840
```
